#define ROW 0
#define COLUMN 1

#include <LiquidCrystal_I2C.h>


//const int frame_count = 10;
//const int symbol_count = 4;

const byte check_anim[10][4][8] = { { { 0x0, 0x0, 0x0, 0x0, 0x0, 0x8, 0x0, 0x0, }, { 0x0, 0x0, 0x0, 0x0, 0x0, 0x0, 0x0, 0x0, }, { 0x0, 0x0, 0x0, 0x0, 0x0, 0x0, 0x0, 0x0, }, { 0x0, 0x0, 0x0, 0x0, 0x0, 0x0, 0x0, 0x0, }, }, { { 0x0, 0x0, 0x0, 0x0, 0x0, 0x0, 0x4, 0x4, }, { 0x0, 0x0, 0x0, 0x0, 0x0, 0x0, 0x0, 0x0, }, { 0x0, 0x0, 0x0, 0x0, 0x0, 0x0, 0x0, 0x0, }, { 0x0, 0x0, 0x0, 0x0, 0x0, 0x0, 0x0, 0x0, }, }, { { 0x0, 0x0, 0x0, 0x0, 0x0, 0x0, 0x0, 0x4, }, { 0x0, 0x0, 0x0, 0x0, 0x0, 0x0, 0x0, 0x0, }, { 0x6, 0x2, 0x0, 0x0, 0x0, 0x0, 0x0, 0x0, }, { 0x0, 0x0, 0x0, 0x0, 0x0, 0x0, 0x0, 0x0, }, }, { { 0x0, 0x0, 0x0, 0x0, 0x0, 0x0, 0x0, 0x0, }, { 0x0, 0x0, 0x0, 0x0, 0x0, 0x0, 0x0, 0x0, }, { 0x0, 0x3, 0x1, 0x0, 0x0, 0x0, 0x0, 0x0, }, { 0x0, 0x0, 0x10, 0x10, 0x0, 0x0, 0x0, 0x0, }, }, { { 0x0, 0x0, 0x0, 0x0, 0x0, 0x0, 0x0, 0x0, }, { 0x0, 0x0, 0x0, 0x0, 0x0, 0x0, 0x0, 0x0, }, { 0x0, 0x1, 0x1, 0x0, 0x0, 0x0, 0x0, 0x0, }, { 0x4, 0xC, 0x18, 0x10, 0x0, 0x0, 0x0, 0x0, }, }, { { 0x0, 0x0, 0x0, 0x0, 0x0, 0x0, 0x0, 0x0, }, { 0x0, 0x0, 0x0, 0x0, 0x0, 0x0, 0x4, 0x4, }, { 0x0, 0x3, 0x1, 0x0, 0x0, 0x0, 0x0, 0x0, }, { 0xC, 0xC, 0x18, 0x10, 0x0, 0x0, 0x0, 0x0, }, }, { { 0x0, 0x0, 0x0, 0x0, 0x0, 0x0, 0x0, 0x0, }, { 0x0, 0x0, 0x0, 0x0, 0x0, 0x2, 0x6, 0x6, }, { 0x2, 0x3, 0x1, 0x0, 0x0, 0x0, 0x0, 0x0, }, { 0xC, 0xC, 0x18, 0x10, 0x0, 0x0, 0x0, 0x0, }, }, { { 0x0, 0x0, 0x0, 0x0, 0x0, 0x0, 0x0, 0x0, }, { 0x0, 0x0, 0x0, 0x0, 0x2, 0x2, 0x6, 0x6, }, { 0x6, 0x3, 0x1, 0x0, 0x0, 0x0, 0x0, 0x0, }, { 0xC, 0xC, 0x18, 0x10, 0x0, 0x0, 0x0, 0x0, }, }, { { 0x0, 0x0, 0x0, 0x0, 0x0, 0x0, 0x0, 0x0, }, { 0x0, 0x0, 0x0, 0x0, 0x0, 0x0, 0x0, 0x0, }, { 0x0, 0x0, 0x0, 0x0, 0x0, 0x0, 0x0, 0x0, }, { 0x0, 0x0, 0x0, 0x0, 0x0, 0x0, 0x0, 0x0, }, }, { { 0x0, 0x0, 0x0, 0x0, 0x0, 0x0, 0x0, 0x0, }, { 0x0, 0x0, 0x0, 0x0, 0x0, 0x0, 0x0, 0x0, }, { 0x0, 0x0, 0x0, 0x0, 0x0, 0x0, 0x0, 0x0, }, { 0x0, 0x0, 0x0, 0x0, 0x0, 0x0, 0x0, 0x0, }, }, };


enum SeqIndex{
     SEQ_CHECK,
     SEQ_CLOCKS,
     SEQ_QUESTION,
     SEQ_CROSS,
     SEQ_DISCONN,
     SEQUENCE_NUMBER
};


struct BuzzerKeyframe {

    public:
    uint16_t* freq;
    void perform(byte pin){
        if (freq)
            tone(pin,*freq);
        else noTone(pin);
    }
    
};


class LCD1602BlockKeyframe{
    public:
    int8_t rows;
    int8_t columns;
    char* frame[8];
    void perform(LiquidCrystal_I2C &lcd,int8_t top_left[2]){
        for(int8_t r; r<rows;r++)
            for(int8_t c; c<columns;r++){
                lcd.createChar(0,frame[r*rows+columns]);
                lcd.setCursor(top_left[COLUMN]+c,top_left[ROW]+r);
                lcd.write(r*rows+columns);
            }
    }
};

struct SequenceKeyframe{
    LCD1602BlockKeyframe* lcd_keyframe;
    BuzzerKeyframe* buzzer_keyframe;
    uint16_t timestamp;
    SequenceKeyframe(BuzzerKeyframe* buzzer_keyframe,uint16_t timestamp){

    }
};



class Sequence
{
private:
    SequenceKeyframe* seq_keyframe;
    
    
    /* data */
public:
    Sequence(SequenceKeyframe* seq_keyframe){
        
    };
    ~Sequence();
};

// Sequence::Sequence(/* args */)
// {
// }

// Sequence::~Sequence()
// {
// }

// uint32_t N = 4;
//  Seqation*  SeqATIONS = ( Seqation*)malloc(sizeof( Seqation) * N);
//  SeqATIONS[0] =  Seqation(1,2,3,nullptr);

Sequence **SEQUENCES = new Sequence*[SEQUENCE_NUMBER];

// SEQUENCES[SEQ_CHECK] = new Sequence(
//     {0,nullptr,}

//     new SequenceKeyframe()
// );

// Sequence *SEQUENCES = (Sequence *)malloc(sizeof(Sequence) * SEQUENCE_NUMBER);
// SEQUENCES[SEQ_CHECK] = Sequence({nullptr,nullptr});


// static class Sequencer{
//     public:
//         static uint32_t initial_time;
//         static uint8_t  Seq_index;
//         byte* block_positions[2];
//         static void perform( SeqIndex  Seq_index){
//             Sequencer::Seq_index =  Seq_index;
//         }
//         static void begin(){
//             initial_time = millis();
//             for (sizeof() )
//         }
//         static void tick(){
//             for ()
//                 if ()
//         }
// };




